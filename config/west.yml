## config/west.yml
```yaml
manifest:
  remotes:
    - name: zmkfirmware
      url-base: https://github.com/zmkfirmware
    - name: sayu-hub
      url-base: https://github.com/sayu-hub
    - name: caksoylar  # <-- new entry
      url-base: https://github.com/caksoylar  
    - name: shakushakupanda
      url-base: https://github.com/shakushakupanda    
  projects:
    - name: zmk
      remote: zmkfirmware
      revision: main
      import: app/west.yml
    - name: zmk-pmw3610-driver
      remote: shakushakupanda
      revision: main
    - name: zmk-rgbled-widget  # <-- new entry
      remote: shakushakupanda
      revision: main
  self:
    path: config
```
